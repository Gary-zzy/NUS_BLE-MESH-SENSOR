## 52/NUS+sensor_server/Kconfig/boards/Kconfig.defconfig
```kconfig
# Load Zephyr board defconfig descriptions.
osource "C:/ncs/v2.9.0/zephyr/boards/nordic/nrf52833dk/Kconfig.defconfig"
```

## 52/NUS-BLE-MESH-SENSOR/Kconfig/Kconfig.shield
```kconfig
osource "C:/Users/Gary/Desktop/Zephyr/central_uart/boards/shields/*/Kconfig.shield"
osource "C:/Users/Gary/Desktop/Zephyr/peripheral_uart/boards/shields/*/Kconfig.shield"
osource "C:/Users/Gary/Desktop/Zephyr/NUS-BLE-MESH-SENSOR/boards/shields/*/Kconfig.shield"
osource "C:/Users/Gary/Desktop/Zephyr/BLE-Sensor-Server/boards/shields/*/Kconfig.shield"
osource "C:/ncs/v2.9.0/nrf/boards/shields/*/Kconfig.shield"
```

## 52/NUS-BLE-MESH-SENSOR/Kconfig/boards/Kconfig
```kconfig
# Load Zephyr board Kconfig descriptions.
osource "C:/ncs/v2.9.0/zephyr/boards/nordic/nrf52833dk/Kconfig"
```

## 52/sensor_client/Kconfig/Kconfig.shield.defconfig
```kconfig
osource "C:/Users/Gary/Desktop/Zephyr/ble_peripheral_lbs_coex/boards/shields/*/Kconfig.defconfig"
osource "C:/Users/Gary/Desktop/Zephyr/ble_peripheral_lbs_coex_test/boards/shields/*/Kconfig.defconfig"
osource "C:/Users/Gary/Desktop/Zephyr/central_uart/boards/shields/*/Kconfig.defconfig"
osource "C:/Users/Gary/Desktop/Zephyr/peripheral_uart/boards/shields/*/Kconfig.defconfig"
osource "C:/Users/Gary/Desktop/Zephyr/sensor_client/boards/shields/*/Kconfig.defconfig"
osource "C:/Users/Gary/Desktop/Zephyr/sensor_server/boards/shields/*/Kconfig.defconfig"
osource "C:/ncs/v2.9.0/nrf/boards/shields/*/Kconfig.defconfig"
```
